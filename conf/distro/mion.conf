## conf/distro/mion.conf
```bitbake
DISTRO_NAME = "MION (Mini Infrastructure OS for Networking"
DISTRO_VERSION = "${ORYX_VERSION}"
TCLIBCAPPEND = ""

MAINTAINER = "Togán Labs <support@toganlabs.com>"

# Use a reduced set of default distro vars. This can easily be overridden in
# system or application profiles.
DISTRO_FEATURES_DEFAULT = " \
    acl alsa argp bluetooth ext2 ipv4 ipv6 largefile \
    usbhost xattr nfs zeroconf pci 3g nfc \
    "

# Customisation
ROOT_HOME = "/root"
COPY_LIC_MANIFEST = "0"
COPY_LIC_DIRS = "0"

# Use systemd
DISTRO_FEATURES_append = " systemd"
VIRTUAL-RUNTIME_init_manager = "systemd"
DISTRO_FEATURES_BACKFILL_CONSIDERED = "sysvinit"
VIRTUAL-RUNTIME_initscripts = ""

# Customisable version and build identification
ORYX_VERSION ?= "dunfell"
ORYX_BUILD_ID = "${ORYX_VERSION}"

# Image name
ORYX_IMAGE_BASENAME = "mion-${ORYX_SYSTEM_PROFILE}-${ORYX_APPLICATION_PROFILE}"

# Prefer OCI implementations of container tools
PREFERRED_PROVIDER_virtual/runc = "runc-opencontainers"
PREFERRED_PROVIDER_virtual/containerd = "containerd-opencontainers"

# We use the meta-virtualization layer but we don't need the "virtualization"
# distro feature as we're not using xen/kvm.
SKIP_META_VIRT_SANITY_CHECK = "1"

# Default to just spawning a shell inside container guests
ORYX_APPLICATION_COMMAND ?= "/bin/sh"

# Default capabilities to grant to guest containers
# This is copied from the defaults assigned by `runc spec`
ORYX_GUEST_CAPABILITIES ?= " \
    CAP_AUDIT_WRITE \
    CAP_KILL \
    CAP_NET_BIND_SERVICE \
    "

# Blacklist recipes with missing dependencies in our layer setup
INHERIT += "blacklist"
PNBLACKLIST[cri-o] = "Missing dependency 'ostree'"
PNBLACKLIST[nagios-core] = "Missing dependency 'apache2'"
PNBLACKLIST[nagios-plugins] = "Blacklisted dependency 'nagios-core'"
PNBLACKLIST[nagios-nrpe] = "Blacklisted dependency 'nagios-core'"
PNBLACKLIST[nagios-nsca] = "Blacklisted dependency 'nagios-core'"
PNBLACKLIST[packagegroup-meta-oe] = "Bad dependencies"

# Default final output location
ORYX_OUTPUT_DIR ?= "${TOPDIR}/images"

# Allow rm_work to be enabled via an environment variable. We sadly can't use
# oe.utils.conditional() this early so we need to use bb.utils.contains().
INHERIT += "${@bb.utils.contains('ORYX_RM_WORK', '1', 'rm_work', '', d)}"

# Allow mirror archival to be enabled via en environment variable.
INHERIT += "${@bb.utils.contains('ORYX_MIRROR_ARCHIVE', '1', 'archiver', '', d)}"
BB_GENERATE_MIRROR_TARBALLS = "${ORYX_MIRROR_ARCHIVE}"
ARCHIVER_MODE[src] = "mirror"
ARCHIVER_MODE[mirror] = "combined"
ARCHIVER_MIRROR_EXCLUDE = "file://"
COPYLEFT_LICENSE_INCLUDE = "*"
DEPLOY_DIR_SRC = "${ORYX_OUTPUT_DIR}"

# Use Yocto Project mirrors incase sources disappear
PREMIRRORS ??= "\
bzr://.*/.*   http://downloads.yoctoproject.org/mirror/sources/ \n \
cvs://.*/.*   http://downloads.yoctoproject.org/mirror/sources/ \n \
git://.*/.*   http://downloads.yoctoproject.org/mirror/sources/ \n \
gitsm://.*/.* http://downloads.yoctoproject.org/mirror/sources/ \n \
hg://.*/.*    http://downloads.yoctoproject.org/mirror/sources/ \n \
osc://.*/.*   http://downloads.yoctoproject.org/mirror/sources/ \n \
p4://.*/.*    http://downloads.yoctoproject.org/mirror/sources/ \n \
svn://.*/.*   http://downloads.yoctoproject.org/mirror/sources/ \n"

MIRRORS =+ "\
ftp://.*/.*      http://downloads.yoctoproject.org/mirror/sources/ \n \
http://.*/.*     http://downloads.yoctoproject.org/mirror/sources/ \n \
https://.*/.*    http://downloads.yoctoproject.org/mirror/sources/ \n"

# Issue a warning instead of an error if a bbappend file is not matched against
# an original bb file.
BB_DANGLINGAPPENDS_WARNONLY = "1"

# Disable static libraries where possible.
require conf/distro/include/no-static-libs.inc

# Enable additional security flags.
require conf/distro/include/security_flags.inc

# Convert some QA warnings into errors to ensure we get good quality
# reproducible images.
WARN_QA = "libdir xorg-driver-abi textrel incompatible-license files-invalid \
           infodir build-deps symlink-to-sysroot multilib \
           invalid-packageconfig host-user-contaminated uppercase-pn \
           patch-fuzz \
          "

ERROR_QA = "dev-so debug-deps dev-deps debug-files arch pkgconfig la \
            perms dep-cmp pkgvarcheck perm-config perm-line perm-link \
            split-strip packages-list pkgv-undefined var-undefined \
            version-going-backwards expanded-d invalid-chars \
            license-checksum dev-elf file-rdeps configure-unsafe \
            configure-gettext \
            \
            already-stripped compile-host-path install-host-path \
            installed-vs-shipped ldflags pn-overrides rpaths staticdev \
            unknown-configure-option useless-rpaths \
           "

# Profiles
ORYX_SYSTEM_PROFILE ??= "native"
ORYX_APPLICATION_PROFILE ??= "mion-host-prod"

MION_GUEST_INSTALL = "start-sshd \
    openssl \
    wget \
"

MION_HOST_INSTALL = ""

MION_SDK_TARGET_INSTALL = " \
"

MION_SDK_HOST_INSTALL = "\
    "

DISTRO_FEATURES_DEFAULT ?= "acl argp ext2 ipv4 ipv6 largefile nfs pci pcmcia systemd usbgadget usbhost xattr"

VIRTUAL-RUNTIME_init_manager = "systemd"
DISTRO_FEATURES_BACKFILL_CONSIDERED = "sysvinit"
VIRTUAL-RUNTIME_initscripts = ""

VIRTUAL-RUNTIME_login_manager = "systemd"
PREFERRED_PROVIDER_udev ?= "systemd"
PREFERRED_PROVIDER_udev-utils ?= "systemd"

BAD_RECOMMENDATIONS ?= "busybox-syslog"
DISTRO_FEATURES_remove += "alsa"
# onie vars
ONIE_VENDOR ?= "unknown"
# TODO setup a mapping?
ONIE_VENDOR_SHORT ?= "${ONIE_VENDOR}"
ONIE_MACHINE_TYPE ?= "unknown"
ONIE_ARCH ?= "${TARGET_ARCH}"
ONIE_MACHINE ?= "${ONIE_VENDOR_SHORT}_${ONIE_MACHINE_TYPE}"
ONIE_MACHINE_REV ?= "0"
ONIE_PLATFORM ?= "${ONIE_ARCH}-${ONIE_MACHINE}-r${ONIE_MACHINE_REV}"

# onl vars
ONL_DEBIAN_SUITE = "mion"
ONL_PLATFORM="${@'${ONIE_ARCH}-${ONIE_MACHINE}'.replace('_', '-')}"
ONL_ARCH="${@'${ONIE_ARCH}'.replace('_', '-')}"

require conf/system-profiles/${ORYX_SYSTEM_PROFILE}.conf
require conf/application-profiles/${ORYX_APPLICATION_PROFILE}.conf
```

## conf/layer.conf
```bitbake
# We have a conf and classes directory, add to BBPATH
BBPATH .= ":${LAYERDIR}"

# We have recipes-* directories, add to BBFILES
BBFILES += "${LAYERDIR}/recipes-*/*/*.bb \
            ${LAYERDIR}/recipes-*/*/*.bbappend"

BBFILE_COLLECTIONS += "meta-mion"
BBFILE_PATTERN_meta-mion = "^${LAYERDIR}/"
BBFILE_PRIORITY_meta-mion = "6"

LAYERDEPENDS_meta-mion = "core"
LAYERSERIES_COMPAT_meta-mion = "dunfell"
```

## meta-mion-simplerunc/conf/layer.conf
```bitbake
# We have a conf and classes directory, add to BBPATH
BBPATH .= ":${LAYERDIR}"

# We have recipes-* directories, add to BBFILES
BBFILES += "${LAYERDIR}/recipes-*/*/*.bb \
            ${LAYERDIR}/recipes-*/*/*.bbappend"

BBFILE_COLLECTIONS += "meta-mion-simplerunc"
BBFILE_PATTERN_meta-mion-simplerunc = "^${LAYERDIR}/"
BBFILE_PRIORITY_meta-mion-simplerunc = "6"

LAYERDEPENDS_meta-mion-simplerunc = "core meta-mion"
LAYERSERIES_COMPAT_meta-mion-simplerunc = "dunfell"
```

## meta-mion/conf/distro/mion.conf
```bitbake
DISTRO_NAME = "mion (Mini Infrastructure OS for Networking)"
DISTRO_VERSION = "Copeland-2021.03+snapshot"

MAINTAINER = "Togán Labs <support@toganlabs.com>"

ONIE_FILES ??= "${MIONBASE}/meta-mion/files/"

# Customisation
ROOT_HOME = "/root"
COPY_LIC_MANIFEST = "0"
COPY_LIC_DIRS = "0"

# Distro features
DISTRO_FEATURES_DEFAULT = "ext2 ipv6 usbhost nfs pci nfs systemd"
DISTRO_FEATURES_remove += " alsa bluetooth opengl pcmcia wayland wifi x11  3g pulseaudio"

DISTRO_FEATURES_BACKFILL_CONSIDERED = "gobject-introspection-data"

# Use systemd
VIRTUAL-RUNTIME_init_manager = "systemd"
VIRTUAL-RUNTIME_initscripts = ""
VIRTUAL-RUNTIME_login_manager = "shadow-base"
VIRTUAL-RUNTIME_syslog = ""
DISTRO_FEATURES_BACKFILL_CONSIDERED = "sysvinit"
PREFERRED_PROVIDER_udev ?= "systemd"
PREFERRED_PROVIDER_udev-utils ?= "systemd"

# Prefer OCI implementations of container tools
PREFERRED_PROVIDER_virtual/runc = "runc-opencontainers"
PREFERRED_PROVIDER_virtual/containerd = "containerd-opencontainers"

# We use the meta-virtualization layer but we don't need the "virtualization"
# distro feature as we're not using xen/kvm.
SKIP_META_VIRT_SANITY_CHECK = "1"

# Default capabilities to grant to guest containers
# This is copied from the defaults assigned by `runc spec`
MION_GUEST_CAPABILITIES ?= " \
    CAP_AUDIT_WRITE \
    CAP_KILL \
    CAP_NET_BIND_SERVICE \
    CAP_SYS_CHROOT \
    CAP_SYS_RAWIO \
    CAP_IPC_OWNER \
    CAP_SETGID \
    CAP_SETUID \
    "

# Blacklist recipes with missing dependencies in our layer setup
INHERIT += "blacklist"
PNBLACKLIST[cri-o] = "Missing dependency 'ostree'"
PNBLACKLIST[nagios-core] = "Missing dependency 'apache2'"
PNBLACKLIST[nagios-plugins] = "Blacklisted dependency 'nagios-core'"
PNBLACKLIST[nagios-nrpe] = "Blacklisted dependency 'nagios-core'"
PNBLACKLIST[nagios-nsca] = "Blacklisted dependency 'nagios-core'"
PNBLACKLIST[packagegroup-meta-oe] = "Bad dependencies"

# mion SDK bits
SDK_VENDOR = "-mionsdk"
SDK_VERSION = "${@d.getVar('DISTRO_VERSION').replace('snapshot-${DATE}', 'snapshot')}"

TARGET_VENDOR = "-mion"

LOCALCONF_VERSION = "1"

DISTRO_VERSION[vardepsexclude] = "DATE"
SDK_VERSION[vardepsexclude] = "DATE"

SDK_NAME = "${DISTRO}-${TCLIBC}-${SDKMACHINE}-${IMAGE_BASENAME}-${TUNE_PKGARCH}-${MACHINE}"
SDKPATH = "/opt/${DISTRO}/${SDK_VERSION}"

PREMIRRORS ??= "\
bzr://.*/.*   http://downloads.yoctoproject.org/mirror/sources/ \n \
cvs://.*/.*   http://downloads.yoctoproject.org/mirror/sources/ \n \
git://.*/.*   http://downloads.yoctoproject.org/mirror/sources/ \n \
gitsm://.*/.* http://downloads.yoctoproject.org/mirror/sources/ \n \
hg://.*/.*    http://downloads.yoctoproject.org/mirror/sources/ \n \
osc://.*/.*   http://downloads.yoctoproject.org/mirror/sources/ \n \
p4://.*/.*    http://downloads.yoctoproject.org/mirror/sources/ \n \
svn://.*/.*   http://downloads.yoctoproject.org/mirror/sources/ \n"

MIRRORS =+ "\
ftp://.*/.*      http://downloads.yoctoproject.org/mirror/sources/ \n \
http://.*/.*     http://downloads.yoctoproject.org/mirror/sources/ \n \
https://.*/.*    http://downloads.yoctoproject.org/mirror/sources/ \n"

# Issue a warning instead of an error if a bbappend file is not matched against
# an original bb file.
BB_DANGLINGAPPENDS_WARNONLY = "1"

# Disable static libraries where possible.
require conf/distro/include/no-static-libs.inc

# Enable additional security flags.
require conf/distro/include/security_flags.inc

# Convert some QA warnings into errors to ensure we get good quality
# reproducible images.
WARN_QA = "libdir xorg-driver-abi textrel incompatible-license files-invalid \
           infodir build-deps symlink-to-sysroot multilib \
           invalid-packageconfig host-user-contaminated uppercase-pn \
           patch-fuzz \
          "

ERROR_QA = "dev-so debug-deps dev-deps debug-files arch pkgconfig la \
            perms dep-cmp pkgvarcheck perm-config perm-line perm-link \
            split-strip packages-list pkgv-undefined var-undefined \
            version-going-backwards expanded-d invalid-chars \
            license-checksum dev-elf file-rdeps configure-unsafe \
            configure-gettext \
            \
            already-stripped compile-host-path install-host-path \
            installed-vs-shipped ldflags pn-overrides rpaths staticdev \
            unknown-configure-option useless-rpaths \
           "



# OELAYOUT_ABI allows us to notify users when the format of TMPDIR changes in
# an incompatible way. Such changes should usually be detailed in the commit
# that breaks the format and have been previously discussed on the mailing list
# with general agreement from the core team.
#
OELAYOUT_ABI = "12"

# Speed up builds and squish the need to run some of the native bits
require conf/distro/include/yocto-uninative.inc
INHERIT += "uninative"

INHERIT += "reproducible_build"

BB_SIGNATURE_HANDLER ?= "OEEquivHash"
BB_HASHSERVE ??= "auto"
```
